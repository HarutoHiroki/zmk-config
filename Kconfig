## Kconfig
```kconfig
# Custom OLED status screen options.

config OLED_LABEL_TEXT
    string "Text shown in the corner of the custom OLED status screen"
    default "HaruKeeb"
    help
      Static nickname/label shown in the bottom-right of the peripheral
      (right) half's OLED. Keep it short (a handful of characters) so it
      fits on 128x32.
```
