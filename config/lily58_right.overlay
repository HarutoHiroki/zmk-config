/ {
    right_encoder: encoder_right {
        compatible = "alps,ec11";
        a-gpios = <&pro_micro 21 (GPIO_ACTIVE_HIGH | GPIO_PULL_UP)>;
        b-gpios = <&pro_micro 20 (GPIO_ACTIVE_HIGH | GPIO_PULL_UP)>;
        steps = <48>;
        status = "okay";
    };

    encoder_left {
        status = "disabled";
    };
};
